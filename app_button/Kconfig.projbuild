## app_button/Kconfig.projbuild
```kconfig
menu "App Button Configuration"

    config APP_BUTTON_GPIO_NUM
        int "GPIO pin"
        default 9
        help
            GPIO pin to use as button input. Defaults to the BOOT button on most boards (at pin 9).

    config APP_BUTTON_IS_ACTIVE_HIGH
        bool "Is active HIGH?"
        default true
        help
            True: active HIGH, False: active LOW 

endmenu
```

## app_led/Kconfig.projbuild
```kconfig
menu "App LED Control"

    choice APP_LED_TYPE
        prompt "LED type"
        default APP_LED_TYPE_WS2812
        help
            The protocol used by the LED connected to the project.

        config APP_LED_TYPE_WS2812
            bool "WS2812 LED strip"
            help
                Controlled by a single GPIO pin.
        
        config APP_LED_TYPE_LEDC
            bool "LEDC"
            help
                Controlled by R, G, B GPIO pins.
        
    endchoice

    menu "WS2812 Configuration"
        depends on APP_LED_TYPE_WS2812

        config APP_LED_WS2812_GPIO_NUM
            int "GPIO pin"
            default 8
    endmenu

    menu "LEDC Configuration"
        depends on APP_LED_TYPE_LEDC
        
        config APP_LED_LEDC_GPIO_NUM_R
            int "GPIO pin (red channel)"
            default 0
        config APP_LED_LEDC_GPIO_NUM_G
            int "GPIO pin (green channel)"
            default 1
        config APP_LED_LEDC_GPIO_NUM_B
            int "GPIO pin (blue channel)"
            default 8
    endmenu
endmenu
```
